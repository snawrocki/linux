## Documentation/devicetree/bindings/camera/samsung-s5k6aafx.txt
```
Samsung S5K6AAFX camera sensor
------------------------------

Required properties:

- compatible	  : "samsung,s5k6aafx";
- reg		  : base address of the device on I2C bus;
- vdd_core-supply : digital core voltage supply 1.5V (1.4V to 1.6V);
- vdda-supply	  : analog circuits voltage supply 2.8V (2.6V to 3.0V);
- vdd_reg-supply  : regulator input voltage supply 1.8V (1.7V to 1.9V)
		    or 2.8V (2.6V to 3.0);
- vddio-supply	  : I/O voltage supply 1.8V (1.65V to 1.95V)
		    or 2.8V (2.5V to 3.1V);
- video-bus-type  : sensor video output bus type, must be one of:
		    "itu-601", "mipi-csi2";
- clock-frequency : the sensor's master clock frequency in Hz;

Optional properties:

- data-lanes		   : number of physical MIPI-CSI2 data lanes used
			     (default is 2 when this property is not specified);
- gpios			   : specifies gpios connected to the sensor's reset
			     reset (RSTN) and standby (STBYN)  pins, the order
			     of gpios is: <RSTN, STBYN>; If any of these gpios
			     is not used, its specifier shall be 0;
- samsung,s5k6aa-gpio-lvls : this property (bits [1:0]) specifies an active
			     state of the S5K6AAFX reset and stand-by signals;
			     the meaning of bits is: bit[1:0] = [RST, STBY],
			     e.g. bit[1] = 0 indicates the GPIO driving the
			     S5K6AAFX's standby pin should be set to 1 to bring
			     the sensor out from stand-by to normal operation
			     state.
- samsung,s5k6aa-hflip     : sets the default horizontal image flipping;
- samsung,s5k6aa-vflip     : sets the default vertical image flipping;


Example:

	gpl2: gpio-controller@0 {
	};

	reg0: regulator@0 {
	};

	reg1: regulator@1 {
	};

	reg2: regulator@2 {
	};

	reg3: regulator@3 {
	};

	s5k6aafx@3c {
		compatible = "samsung,s5k6aafx";
		reg = <0x3c>;
		clock-frequency = <24000000>;
		gpios = <&gpl2 1 2 0 3>, /* reset */
		        <&gpl2 2 2 0 3>; /* stand-by */
		samsung,s5k6aa-gpio-lvls = <0x0>;
		video-bus-type = 'itu-601';
		vdd_core-supply = <&reg0>;
		vdda-supply = <&reg1>;
		vdd_reg-supply = <&reg2>;
		vddio-supply = <&reg3>;
	};
```

## Documentation/devicetree/bindings/camera/soc/samsung-fimc.txt
```
Samsung S5P/EXYNOS SoC Camera Subsystem (FIMC)
----------------------------------------------

The Exynos Camera subsystem uses a dedicated device node associated with
top level device driver that manages common properties of the whole subsystem,
like common camera port pins or clocks for external image sensors. This
aggregate node references related platform sub-devices - FIMC, FIMC-LITE,
MIPI-CSIS [1], and it also contains nodes describing image sensors wired to
the host SoC's video port and using I2C or SPI as the control bus.


Common 'camera' node
--------------------

Required properties:

- compatible	   : must be "samsung,fimc"
- fimc-controllers : an array of phandles to 'fimc' device nodes,
		     size of this array must be at least 1;

Optional properties:

- csis-controllers : an array of phandles to 'csis' (CSI Slave) device nodes,
		     it is required for sensors with MIPI-CSI2 bus;

- samsung,camport-a-gpios, samsung,camport-b-gpios : gpio specifier list for
			   the parallel camera ports A and B respectively;

  For 'itu-601' video bus the list length must be 13, for 'itu-656' at least
  10 and for 'video-mipi-csi2-bus' the array should contain at least one gpio
  (CLKOUT). The meaning of the gpios is as following: DATA[7:0], PCLK, VSYNC,
  HREF, CLKOUT, FIELD. It is not required to list gpios exactly in that order.
  All gpios listed here will be configured into camera port function.
  In case of ITU-R BT.656 bus the VSYNC, HREF, and FIELD pins remain unused,
  hence don't need to be specified here.


'fimc' device node
------------------

Required properties:

- compatible : should be one of:
		"samsung,s5pv210-fimc"
		"samsung,exynos4210-fimc";
		"samsung,exynos4412-fimc";
- reg	     : physical base address and size of the device memory mapped
	       registers;
- interrupts : FIMC interrupt to the CPU should be described here;
- cell-index : FIMC IP instance index, the number of available instances
	       depends on the SoC revision. For S5PV210 valid values are:
	       0...2, for Exynos4x1x: 0...3.


'fimc-lite' device node
-----------------------

Required properties:

- compatible : should be one of:
		"samsung,exynos4212-fimc";
		"samsung,exynos4412-fimc";
- reg	     : physical base address and size of the device's memory mapped
	       registers;
- interrupts : should contain FIMC-LITE interrupt;
- cell-index : FIMC-LITE IP instance index;


The 'sensor' nodes
------------------

Required properties:

 - i2c-client : a phandle to an image sensor I2C client device;

Optional properties:

- samsung,camif-mux-id : FIMC video multiplexer input index; for camera
			 port A, B, C the indexes are 0, 1, 0 respectively.
			 If this property is not specified a default 0
			 value will be used by driver.

- samsung,fimc-camclk-id : the SoC CAM_MCLK clock output index. These clocks
			   are master clocks for external image processors.
			   If this property is not specified a default 0 value
			   will be used by driver.

 "video-bus-type" and "clock-frequency" properties must be specified at the
 node referenced by 'i2c-client' phandle.

Example:

	fimc0: fimc@11800000 {
		compatible = "samsung,exynos4210-fimc";
		reg = <0x11800000 0x1000>;
		interrupts = <0 85 0>;
		cell-index = <0>;
	};

	csis0: csis@11880000 {
		compatible = "samsung,exynos4210-csis";
		reg = <0x11880000 0x1000>;
		interrupts = <0 78 0>;
		cell-index = <0>;
	};

	camera {
		compatible = "samsung,fimc";
		#address-cells = <1>;
		#size-cells = <1>;
		fimc-controllers = <&fimc0>;
		csis-controllers = <&csis0>;
	};

[1] Documentation/devicetree/bindings/video/samsung-mipi-csis.txt
```

## Documentation/devicetree/bindings/video/mipi.txt
```
Common properties of MIPI-CSI1 and MIPI-CSI2 receivers and transmitters

 - data-lanes : number of differential data lanes wired and actively used in
		communication between the transmitter and the receiver, this
		excludes the clock lane;
```

## Documentation/devicetree/bindings/video/samsung-mipi-csis.txt
```
Samsung S5P/EXYNOS SoC MIPI-CSI2 receiver (MIPI CSIS)
-----------------------------------------------------

Required properties:

- compatible - one of :
		"samsung,s5pv210-csis",
		"samsung,exynos4210-csis",
		"samsung,exynos4212-csis",
		"samsung,exynos4412-csis";
- reg : physical base address and size of the device memory mapped registers;
- interrupts      : should contain MIPI CSIS interrupt; the format of the
		    interrupt specifier depends on the interrupt controller;
- cell-index      : the hardware instance index;
- clock-frequency : The IP's main (system bus) clock frequency in Hz, the default
		    value when this property is not specified is 166 MHz;
- data-lanes      : number of physical MIPI-CSI2 lanes used;
- samsung,csis-hs-settle : differential receiver (HS-RX) settle time;
- vddio-supply    : MIPI CSIS I/O and PLL voltage supply (e.g. 1.8V);
- vddcore-supply  : MIPI CSIS Core voltage supply (e.g. 1.1V).

Example:

	reg0: regulator@0 {
	};

	reg1: regulator@1 {
	};

/* SoC properties */

	csis@11880000 {
		compatible = "samsung,exynos4210-csis";
		reg = <0x11880000 0x1000>;
		interrupts = <0 78 0>;
		cell-index = <0>;
	};

/* Board properties */

	csis@11880000 {
		clock-frequency = <166000000>;
		data-lanes = <2>;
		samsung,csis-hs-settle = <12>;
		vddio-supply = <&reg0>;
		vddcore-supply = <&reg1>;
	};
```

## Documentation/devicetree/bindings/video/video.txt
```
Common properties of video data source devices (image sensors, video encoders, etc.)

Video bus type
---------------

- video-bus-type : valid values are:

    - itu-601   : parallel bus with HSYNC and VSYNC - ITU-R BT.601;
    - itu-656   : parallel bus with embedded synchronization - ITU-R BT.656;
    - mipi-csi2 : MIPI-CSI2 serial bus;

Video bus signal polarity flags
-------------------------------

- video-bus-polarity : video bus signal polarity flags, bits [4:0] encoded
		       as follows:
    0x01 = active state of the horizontal synchronization signal (HSYNC);
    0x02 = active state of the vertical synchronization signal (VSYNC);
    0x04 = the pixel clock sampling edge; 1 - rising edge, 0 - falling edge;
    0x08 = active state of the data signal;
    0x10 = the FIELD signal's inversion; if this flag is cleared the meaning
	   of FIELD signal is:
	   0:  FIELD - 0/1 = Field1 (odd)/Field2 (even);
	   if this flag is cleared the meaning of FIELD signal is:
	   16: FIELD - 1/0 = Field1 (odd)/Field2 (even);
```
